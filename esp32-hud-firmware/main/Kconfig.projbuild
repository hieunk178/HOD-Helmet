## esp32-hud-firmware/main/Kconfig.projbuild
```kconfig
menu "HUD Helmet Configuration"

    choice HUD_DISPLAY_TYPE
        prompt "Display type"
        default HUD_DISPLAY_ST7735
        help
            Select the TFT display controller type.
            Use ST7735 for real 0.96 inch hardware.
            Use ST7789 for real 1.3 inch hardware.
            Use ILI9341 for Wokwi simulator testing.

        config HUD_DISPLAY_ST7735
            bool "ST7735 (Real hardware - 0.96 inch 160x80)"

        config HUD_DISPLAY_ST7789
            bool "ST7789 (Real hardware - 1.3 inch 240x240)"

        config HUD_DISPLAY_ILI9341
            bool "ILI9341 (Wokwi simulator - 240x320)"
    endchoice

    config HUD_DISPLAY_WIDTH
        int
        default 160 if HUD_DISPLAY_ST7735
        default 240 if HUD_DISPLAY_ST7789
        default 320 if HUD_DISPLAY_ILI9341

    config HUD_DISPLAY_HEIGHT
        int
        default 80 if HUD_DISPLAY_ST7735
        default 240 if HUD_DISPLAY_ST7789
        default 240 if HUD_DISPLAY_ILI9341

    config HUD_HAS_BACKLIGHT_PIN
        bool "Enable backlight GPIO control"
        default y if HUD_DISPLAY_ST7735
        default y if HUD_DISPLAY_ST7789
        default n if HUD_DISPLAY_ILI9341
        help
            Enable hardware backlight pin control.
            Disable for Wokwi simulator (no backlight pin).

    config ESP_WIFI_SSID
        string "WiFi SSID"
        default "Wokwi-GUEST" if HUD_DISPLAY_ILI9341
        default "YourWiFiSSID"
        help
            SSID (network name) for the HUD to connect to.
            Use "Wokwi-GUEST" for Wokwi simulator (open network).

    config ESP_WIFI_PASSWORD
        string "WiFi Password"
        default "" if HUD_DISPLAY_ILI9341
        default "YourWiFiPassword"
        help
            WiFi password (WPA or WPA2) for the network.
            Leave empty for Wokwi-GUEST open network.

    config ESP_WIFI_MAX_RETRY
        int "Maximum retry"
        default 5
        help
            Set the Maximum retry to avoid station reconnecting to the AP unlimited when the AP is really inexistent.

    config HUD_NOTIFICATION_TIMEOUT_SEC
        int "Notification display timeout (seconds)"
        default 30
        help
            Time in seconds before a notification is automatically dismissed from the HUD display.

endmenu
```

## esp32-hud-firmware/sdkconfig.defaults
```kconfig
# ESP32 HUD Helmet - Real Hardware SDK Configuration
# Target: ESP32-S3 R16N8 (16MB Flash + 8MB Octal PSRAM)

# Display: ST7789 for Real Hardware
CONFIG_HUD_DISPLAY_ST7789=y
CONFIG_HUD_DISPLAY_WIDTH=240
CONFIG_HUD_DISPLAY_HEIGHT=240
CONFIG_HUD_HAS_BACKLIGHT_PIN=y

# Wi-Fi: Change to match your access point
CONFIG_ESP_WIFI_SSID="Xomtrovuive"
CONFIG_ESP_WIFI_PASSWORD="11111111"
CONFIG_ESP_WIFI_MAX_RETRY=5

# HTTP Server
CONFIG_HTTPD_MAX_REQ_HDR_LEN=1024
CONFIG_HTTPD_MAX_URI_LEN=512

# Log level
CONFIG_LOG_DEFAULT_LEVEL_INFO=y
CONFIG_LOG_DEFAULT_LEVEL=3

# Compiler Optimization: use -O2 (PERF) to avoid GCC ICE bug in esp_lcd_panel_rgb.c with -Og
CONFIG_COMPILER_OPTIMIZATION_PERF=y

# CPU Frequency
CONFIG_ESP_DEFAULT_CPU_FREQ_MHZ_240=y
CONFIG_ESP_DEFAULT_CPU_FREQ_MHZ=240

# FreeRTOS
CONFIG_FREERTOS_HZ=1000

# Partition Table - Custom
CONFIG_PARTITION_TABLE_CUSTOM=y
CONFIG_PARTITION_TABLE_CUSTOM_FILENAME="partitions.csv"

# Flash Size: 16MB for R16N8
CONFIG_ESPTOOLPY_FLASHSIZE_16MB=y
CONFIG_ESPTOOLPY_FLASHSIZE="16MB"

# PSRAM: 8MB Octal PSRAM for R16N8
CONFIG_SPIRAM=y
CONFIG_SPIRAM_MODE_OCT=y
CONFIG_SPIRAM_SPEED_80M=y
CONFIG_SPIRAM_BOOT_INIT=y
CONFIG_SPIRAM_IGNORE_NOTFOUND=y
CONFIG_SPIRAM_USE_MALLOC=y

# LVGL Configuration
CONFIG_LV_CONF_SKIP=y
CONFIG_LV_COLOR_DEPTH_16=y
CONFIG_LV_COLOR_16_SWAP=y
CONFIG_LV_MEM_CUSTOM=y

# Fonts
CONFIG_LV_FONT_MONTSERRAT_12=y
CONFIG_LV_FONT_MONTSERRAT_16=y
CONFIG_LV_FONT_MONTSERRAT_24=y
CONFIG_LV_FONT_MONTSERRAT_32=y
CONFIG_LV_FONT_MONTSERRAT_48=y

CONFIG_HTTPD_WS_SUPPORT=y
```
